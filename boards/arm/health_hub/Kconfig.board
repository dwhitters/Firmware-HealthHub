## boards/arm/health_hub/Kconfig.board
```kconfig
# Health Hub board configuration

config HEALTH_HUB_NRF52832
	bool "Health Hub NRF52832"
	depends on SOC_NRF52832_QFAA
```

## boards/arm/health_hub/Kconfig.defconfig
```kconfig
# Health Hub board configuration

if HEALTH_HUB_NRF52832

config BOARD
	default "health_hub"

config BT_CTLR
	default BT

endif
```
